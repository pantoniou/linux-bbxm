## drivers/capebus/Kconfig
```kconfig
#
# Capebus core support
#

menu "CAPEBUS support"

config CAPEBUS_CORE
	bool "Capebus support"
	default n
	help
	  Enable to support capebus devices.

source "drivers/capebus/boards/Kconfig"

source "drivers/capebus/capes/Kconfig"

endmenu
```

## drivers/capebus/capes/Kconfig
```kconfig
config CAPEBUS_BONE_DVI
	tristate "Beaglebone DVI cape driver"
	depends on CAPEBUS_BONE_CONTROLLER
	default n
	help
	  "Select this to enable a driver for the DVI cape"

config CAPEBUS_BONE_GEIGER
	tristate "Beaglebone Geiger cape driver"
	depends on CAPEBUS_BONE_CONTROLLER
	default n
	help
	  "Select this to enable a driver for the geiger cape"
```

## drivers/staging/pvrsgx/Kconfig
```kconfig
config PVR_SGX
       tristate "PowerVR SGX support"
       help
          This enables PowerVR SGX support.

	  To compile this driver as a module, say M here:  the module will
	  be called firewire-serial.
```
