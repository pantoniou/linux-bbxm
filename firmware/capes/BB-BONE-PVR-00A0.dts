/*
 * Copyright (C) 2013 CircuitCo
 *
 * Virtual cape for PVR SGX
 *
 * This program is free software; you can redistribute it and/or modify
 * it under the terms of the GNU General Public License version 2 as
 * published by the Free Software Foundation.
 */
/dts-v1/;
/plugin/;

/ {
	compatible = "ti,beaglebone", "ti,beaglebone-black";

	/* identification */
	part-number = "BB-BONE-PVR";
	version = "00A0";

	/* state the resources this cape uses */
	exclusive-use =
		/* the hardware ip uses */
		"sgx";

	fragment@0 {
		target = <&ocp>;
		__overlay__ {
			pvrsrvkm {
				compatible = "pvrsrvkm";
				ti,hwmod = "gfx";
				status = "okay";
			};
		};
	};
};
